## components/lua_modules/lua_module_display/Kconfig
```kconfig
menu "Lua Display Module"

    config LUA_MODULE_DISPLAY_RGB565_SWAP_ON
        bool "Swap RGB565 bytes before IO panel submission"
        default y
        help
            Swap each RGB565 pixel before it is submitted.

endmenu
```

## components/lua_modules/lua_module_imu/Kconfig
```kconfig
menu "Lua IMU Module"

    config LUA_MODULE_IMU_CHIP_BMI270
        bool "BMI270 backend"
        default y

    config LUA_MODULE_IMU_CHIP_MPU6050
        bool "MPU6050 backend"
        default n

    config LUA_MODULE_IMU_CHIP_ICM42670
        bool "ICM42670 backend"
        default n

endmenu
```

## components/lua_modules/lua_module_ir/Kconfig
```kconfig
menu "Lua IR Module"

    config LUA_MODULE_IR_DEFAULT_CARRIER_HZ
        int "Default IR carrier frequency in Hz"
        default 38000
        range 30000 56000
        help
            Default carrier frequency used when transmitting IR signals.

    config LUA_MODULE_IR_DEFAULT_TX_RESOLUTION_HZ
        int "Default RMT TX resolution in Hz"
        default 1000000
        help
            Default RMT counter resolution for IR TX, 1MHz means 1 tick = 1us.

    config LUA_MODULE_IR_DEFAULT_RX_RESOLUTION_HZ
        int "Default RMT RX resolution in Hz"
        default 500000
        help
            Default RMT counter resolution for IR RX. 500kHz lets the 15-bit idle
            threshold cover the 60ms default receive gap needed by long A/C frames.

    config LUA_MODULE_IR_RX_MAX_SYMBOLS
        int "Max symbols per IR RX frame"
        default 512
        range 32 2048
        help
            Default rx_max_symbols of ir.device: the RX buffer, in RMT symbols,
            used by every receive. A frame that fills it is reported as
            frame_too_long. Raise this for long protocols (e.g. air-conditioner
            frames) or repeated NEC bursts captured in a single shot.

endmenu
```

## components/lua_modules/lua_module_magnetometer/Kconfig
```kconfig
menu "Lua Magnetometer Module"

    config LUA_MODULE_MAGNETOMETER_CHIP_BMM350
        bool "BMM350 backend"
        default y

    config LUA_MODULE_MAGNETOMETER_CHIP_BMM150
        bool "BMM150 backend"
        default n

    config LUA_MODULE_MAGNETOMETER_CHIP_QMC6309
        bool "QMC6309 backend"
        default n

endmenu
```

## framework/services/debug-console/test_apps/espidf_console_smoke/sdkconfig.defaults
```kconfig
CONFIG_COMPILER_OPTIMIZATION_SIZE=y
CONFIG_BOOTLOADER_COMPILER_OPTIMIZATION_SIZE=y
CONFIG_ESP_TASK_WDT_INIT=n
CONFIG_FREERTOS_HZ=1000
```

## framework/services/network/wifi_manager/Kconfig
```kconfig
menu "Wi-Fi Manager"

    config WIFI_MANAGER_AP_SSID_PREFIX
        string "Provisioning AP SSID prefix"
        default "esp-claw"
        help
            Prefix used to build the unique provisioning AP SSID. The full
            SSID is "<prefix>-<MAC[3..5]>" (for example, esp-claw-84AEE5).

    config WIFI_MANAGER_AP_CHANNEL
        int "Provisioning AP channel"
        range 1 13
        default 1
        help
            Channel used by the provisioning SoftAP.

    config WIFI_MANAGER_AP_MAX_CONN
        int "Provisioning AP max connections"
        range 1 10
        default 4
        help
            Maximum number of concurrent stations on the provisioning AP.

    config WIFI_MANAGER_MAX_RETRY
        int "STA max retries before AP fallback"
        range 1 20
        default 5
        help
            After this many consecutive STA connection failures the device
            falls back to pure AP mode and waits for the user to provision
            new credentials.

endmenu
```
