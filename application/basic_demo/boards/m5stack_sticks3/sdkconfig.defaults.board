## application/edge_agent/boards/espressif/esp_vocat_board_v1_2/sdkconfig.defaults.board
```kconfig
CONFIG_ESP_DEFAULT_CPU_FREQ_MHZ_240=y
CONFIG_ESPTOOLPY_FLASHMODE_QIO=y
CONFIG_ESPTOOLPY_FLASHFREQ_80M=y
CONFIG_ESPTOOLPY_FLASHSIZE_16MB=y
CONFIG_SPIRAM=y
CONFIG_SPIRAM_MODE_OCT=y
CONFIG_SPIRAM_SPEED_80M=y
CONFIG_APP_CLAW_LUA_MODULE_IMU=y
CONFIG_ESP_CONSOLE_USB_SERIAL_JTAG=y
CONFIG_LUA_MODULE_IMU_CHIP_BMI270=y
CONFIG_ESP_LCD_TOUCH_CST816S_DISABLE_READ_ID=y
CONFIG_APP_CLAW_LUA_MODULE_FUEL_GAUGE=y
```

## application/edge_agent/boards/lceda-course-examples/eda_ai_gamebox/sdkconfig.defaults.board
```kconfig
CONFIG_ESP_DEFAULT_CPU_FREQ_MHZ_240=y

# 8MB flash, QIO 80MHz
CONFIG_ESPTOOLPY_FLASHMODE_QIO=y
CONFIG_ESPTOOLPY_FLASHFREQ_80M=y
CONFIG_ESPTOOLPY_FLASHSIZE_8MB=y
CONFIG_PARTITION_TABLE_CUSTOM=y
CONFIG_PARTITION_TABLE_CUSTOM_FILENAME="partitions_8MB.csv"

# 8MB PSRAM
CONFIG_SPIRAM=y
CONFIG_SPIRAM_MODE_OCT=y
CONFIG_SPIRAM_SPEED_80M=y

# LCD: ST7789 240x320
CONFIG_LCD_ST7789_240X320=y

# USB: Serial JTAG
CONFIG_ESP_CONSOLE_USB_SERIAL_JTAG=y
CONFIG_ESP_CONSOLE_SECONDARY_NONE=y
```

## application/edge_agent/boards/lceda-course-examples/eda_robot_pro/sdkconfig.defaults.board
```kconfig
CONFIG_ESP_DEFAULT_CPU_FREQ_MHZ_240=y

# 16MB flash, QIO 80MHz
CONFIG_ESPTOOLPY_FLASHMODE_QIO=y
CONFIG_ESPTOOLPY_FLASHFREQ_80M=y
CONFIG_ESPTOOLPY_FLASHSIZE_16MB=y
CONFIG_PARTITION_TABLE_CUSTOM=y
CONFIG_PARTITION_TABLE_CUSTOM_FILENAME="partitions_16MB.csv"

# PSRAM (if available on module)
CONFIG_SPIRAM=y
CONFIG_SPIRAM_MODE_OCT=y
CONFIG_SPIRAM_SPEED_80M=y

# Audio: internal/dummy codec over I2S (MAX98357 + INMP441)
CONFIG_CODEC_DUMMY_SUPPORT=y
CONFIG_ESP_BOARD_PERIPH_I2S_SUPPORT=y

# OLED: SSD1306 128x64
CONFIG_OLED_SSD1306_128X64=y

# USB: Serial JTAG
CONFIG_ESP_CONSOLE_USB_SERIAL_JTAG=y
CONFIG_ESP_CONSOLE_SECONDARY_NONE=y
```

## application/edge_agent/boards/lceda-course-examples/eda_tv_pro/sdkconfig.defaults.board
```kconfig
CONFIG_ESP_DEFAULT_CPU_FREQ_MHZ_240=y

# 8MB flash (per original config)
CONFIG_ESPTOOLPY_FLASHMODE_QIO=y
CONFIG_ESPTOOLPY_FLASHFREQ_80M=y
CONFIG_ESPTOOLPY_FLASHSIZE_8MB=y
CONFIG_PARTITION_TABLE_CUSTOM=y
CONFIG_PARTITION_TABLE_CUSTOM_FILENAME="partitions_8MB.csv"

# Audio: internal/dummy codec over I2S (MAX98357 + INMP441)
CONFIG_CODEC_DUMMY_SUPPORT=y
CONFIG_ESP_BOARD_PERIPH_I2S_SUPPORT=y

# LCD: ST7789 240x240
CONFIG_LCD_ST7789_240X240_7PIN=y

# USB: Serial JTAG
CONFIG_ESP_CONSOLE_USB_SERIAL_JTAG=y
CONFIG_ESP_CONSOLE_SECONDARY_NONE=y
```

## application/edge_agent/boards/m5stack/m5stack_cores3/sdkconfig.defaults.board
```kconfig
CONFIG_ESP_DEFAULT_CPU_FREQ_MHZ_240=y

# M5Stack CoreS3: 16 MB QIO flash @ 80 MHz
CONFIG_ESPTOOLPY_FLASHMODE_QIO=y
CONFIG_ESPTOOLPY_FLASHFREQ_80M=y
CONFIG_ESPTOOLPY_FLASHSIZE_16MB=y

# M5Stack CoreS3: 8 MB quad PSRAM @ 80 MHz
CONFIG_SPIRAM=y
CONFIG_SPIRAM_MODE_QUAD=y
CONFIG_SPIRAM_SPEED_80M=y

# XIP from PSRAM requires octal PSRAM on ESP32-S3; disable for quad PSRAM.
CONFIG_SPIRAM_XIP_FROM_PSRAM=n
CONFIG_SPIRAM_FETCH_INSTRUCTIONS=n
CONFIG_SPIRAM_RODATA=n

# Quad PSRAM cannot keep the stack accessible while cache is disabled for a flash
# transaction. Force FreeRTOS to allocate task stacks from internal RAM so claw
# tasks tagged CLAW_TASK_STACK_PREFER_PSRAM fall back to internal memory.
CONFIG_FREERTOS_TASK_CREATE_ALLOW_EXT_MEM=n

# USB: Serial JTAG
CONFIG_ESP_CONSOLE_USB_SERIAL_JTAG=y
CONFIG_ESP_CONSOLE_SECONDARY_NONE=y
```

## application/edge_agent/boards/m5stack/m5stack_tab5/sdkconfig.defaults.board
```kconfig
# M5Stack Tab5: 16 MB QIO flash @ 80 MHz
CONFIG_ESPTOOLPY_FLASHMODE_QIO=y
CONFIG_ESPTOOLPY_FLASHFREQ_80M=y
CONFIG_ESPTOOLPY_FLASHSIZE_16MB=y

# M5Stack Tab5: 32 MB quad PSRAM @ 200 MHz
CONFIG_SPIRAM=y
CONFIG_SPIRAM_MODE_HEX=y
CONFIG_SPIRAM_SPEED_200M=y

# USB: Serial JTAG
CONFIG_ESP_CONSOLE_USB_SERIAL_JTAG=y
CONFIG_ESP_CONSOLE_SECONDARY_NONE=y

#
# NOTE! Support of ESP32-P4 rev. <3.0 and >=3.0 is mutually exclusive
#

#
# Read the help text of the option below for explanation
#
CONFIG_ESP32P4_SELECTS_REV_LESS_V3=y
CONFIG_ESP32P4_REV_MIN_100=y

#
# Camera Sensor Configuration
#
CONFIG_CAMERA_SC202CS=y
CONFIG_CAMERA_SC202CS_AUTO_DETECT_MIPI_INTERFACE_SENSOR=y
CONFIG_CAMERA_SC202CS_MIPI_RAW8_1280X720_30FPS=y
CONFIG_CAMERA_SC202CS_MIPI_IF_FORMAT_INDEX_DEFAULT=0
CONFIG_CAMERA_SC202CS_ABSOLUTE_GAIN_LIMIT=63008
CONFIG_CAMERA_SC202CS_DIG_GAIN_PRIORITY=y
CONFIG_CAMERA_SC202CS_DEFAULT_IPA_JSON_CONFIGURATION_FILE=y

#
# Hosted SDIO Configuration
#
CONFIG_ESP_HOSTED_PRIV_SDIO_PIN_CMD_SLOT_1=13
CONFIG_ESP_HOSTED_PRIV_SDIO_PIN_CLK_SLOT_1=12
CONFIG_ESP_HOSTED_PRIV_SDIO_PIN_D0_SLOT_1=11
CONFIG_ESP_HOSTED_PRIV_SDIO_PIN_D1_4BIT_BUS_SLOT_1=10
CONFIG_ESP_HOSTED_PRIV_SDIO_PIN_D2_4BIT_BUS_SLOT_1=9
CONFIG_ESP_HOSTED_PRIV_SDIO_PIN_D3_4BIT_BUS_SLOT_1=8
CONFIG_ESP_HOSTED_SDIO_GPIO_RESET_SLAVE=15
```

## application/edge_agent/boards/movecall/movecall_cuican_esp32s3/sdkconfig.defaults.board
```kconfig
CONFIG_ESP_DEFAULT_CPU_FREQ_MHZ_240=y
CONFIG_ESPTOOLPY_FLASHMODE_QIO=y
CONFIG_ESPTOOLPY_FLASHFREQ_80M=y
CONFIG_ESPTOOLPY_FLASHSIZE_8MB=y
CONFIG_PARTITION_TABLE_CUSTOM=y
CONFIG_PARTITION_TABLE_CUSTOM_FILENAME="partitions_8MB.csv"
CONFIG_SPIRAM=y
CONFIG_SPIRAM_MODE_OCT=y
CONFIG_SPIRAM_SPEED_80M=y

# USB: Serial JTAG
CONFIG_ESP_CONSOLE_USB_SERIAL_JTAG=y
CONFIG_ESP_CONSOLE_SECONDARY_NONE=y
```

## application/edge_agent/boards/seeedstudio/xiao_esp32s3_sense/sdkconfig.defaults.board
```kconfig
# XIAO ESP32-S3 Sense (ESP32-S3R8): 8 MB QIO flash @ 80 MHz
CONFIG_ESP_DEFAULT_CPU_FREQ_MHZ_240=y
CONFIG_ESPTOOLPY_FLASHMODE_QIO=y
CONFIG_ESPTOOLPY_FLASHFREQ_80M=y
CONFIG_ESPTOOLPY_FLASHSIZE_8MB=y

# 8 MB octal PSRAM @ 80 MHz.
# The R8 module's PSRAM is wired to the chip's OPI peripheral, so no GPIO
# conflicts with the camera/SD/mic/LED wiring above.
CONFIG_SPIRAM=y
CONFIG_SPIRAM_MODE_OCT=y
CONFIG_SPIRAM_SPEED_80M=y

# PSRAM is mandatory here: esp_video places camera frame buffers in PSRAM
# (800x600 JPEG needs several hundred KB, which does not fit in internal SRAM
# once WiFi/LwIP, IM bindings, and the claw task tree are loaded).
# Put WiFi station / LwIP buffers in PSRAM to free ~50 KB of internal RAM.
CONFIG_SPIRAM_TRY_ALLOCATE_WIFI_LWIP=y

# FreeRTOS task stacks tagged CLAW_TASK_STACK_PREFER_PSRAM (claw_core,
# claw_memory, claw_event_router, cap_system, cap_scheduler, cap_im_*,
# cap_lua, ...) must be allowed to use external memory. OCT PSRAM keeps
# the stack accessible while flash cache is disabled, so leave the default y.
# Do NOT set CONFIG_FREERTOS_TASK_CREATE_ALLOW_EXT_MEM=n (CoreS3 disables it
# only because it ships with QUAD PSRAM, which cannot).
#
# Keep instruction/rodata fetch from PSRAM disabled: 8 MB flash is enough
# for firmware, and flash-backed execution is faster than PSRAM-backed.
# CONFIG_SPIRAM_FETCH_INSTRUCTIONS is not set
# CONFIG_SPIRAM_RODATA is not set

# USB: Serial/JTAG is the on-board USB-C console.
# GPIO39-42 are reassigned to camera SCCB (39/40) and PDM mic (41/42),
# so JTAG over GPIO is not available. The internal USB PHY is used instead.
CONFIG_ESP_CONSOLE_USB_SERIAL_JTAG=y
CONFIG_ESP_CONSOLE_SECONDARY_NONE=y

# Camera: OV2640 over DVP 8-bit, 20 MHz XCLK.
# The Kconfig name is the actual default that menuconfig reports for
# esp_video's OV2640 driver on this chip:
#   DVP 8-bit, 20 MHz XCLK, 640x480 @ 25 FPS, JPEG
# (The earlier 800x600 @ 30 FPS line was a guess; menuconfig does
# not actually expose that combination for the OV2640.)
CONFIG_ESP_BOARD_DEV_CAMERA_SUPPORT=y
CONFIG_ESP_VIDEO_ENABLE_DVP_VIDEO_DEVICE=y
CONFIG_CAMERA_OV2640=y
CONFIG_CAMERA_OV2640_AUTO_DETECT_DVP_INTERFACE_SENSOR=y
CONFIG_CAMERA_OV2640_DVP_JPEG_640X480_25FPS=y
CONFIG_CAMERA_OV2640_DVP_DEFAULT_FMT_JPEG_640X480_25FPS=y
CONFIG_APP_CLAW_LUA_MODULE_CAMERA=y

# Audio: bare PDM microphone on I2S0 (no codec IC, internal/dummy ADC)
CONFIG_ESP_BOARD_PERIPH_I2S_SUPPORT=y
CONFIG_CODEC_DATA_ADC_SUPPORT=y
CONFIG_APP_CLAW_LUA_MODULE_AUDIO=y
```

## application/edge_agent/boards/waveshare/waveshare_ESP32_S3_RLCD_4_2/sdkconfig.defaults.board
```kconfig
# Waveshare ESP32-S3-RLCD-4.2 board defaults
# SoC: ESP32-S3-WROOM-1-N16R8 (16 MB QIO Flash + 8 MB OPI PSRAM)

CONFIG_ESP_DEFAULT_CPU_FREQ_MHZ_240=y

# Flash: 16 MB, QIO 80 MHz
CONFIG_ESPTOOLPY_FLASHMODE_QIO=y
CONFIG_ESPTOOLPY_FLASHFREQ_80M=y
CONFIG_ESPTOOLPY_FLASHSIZE_16MB=y

# Use the board-specific 16 MB partition table
CONFIG_PARTITION_TABLE_CUSTOM=y
CONFIG_PARTITION_TABLE_CUSTOM_FILENAME="partitions_16MB.csv"

# Octal PSRAM, 80 MHz
CONFIG_SPIRAM=y
CONFIG_SPIRAM_MODE_OCT=y
CONFIG_SPIRAM_SPEED_80M=y

# Enable display_lcd device support for the custom RLCD panel
CONFIG_ESP_BOARD_DEV_DISPLAY_LCD_SUPPORT=y

# Size-optimised build; move FreeRTOS and ring-buffer code out of IRAM to free
# space for the LCD framebuffer, and reduce Wi-Fi IRAM usage similarly.
CONFIG_COMPILER_OPTIMIZATION_SIZE=y
CONFIG_FREERTOS_PLACE_FUNCTIONS_INTO_FLASH=y
CONFIG_FREERTOS_PLACE_SNAPSHOT_FUNCS_INTO_FLASH=y
CONFIG_RINGBUF_PLACE_FUNCTIONS_INTO_FLASH=y
CONFIG_ESP_WIFI_IRAM_OPT=n
CONFIG_ESP_WIFI_RX_IRAM_OPT=n

# USB: Serial JTAG
CONFIG_ESP_CONSOLE_USB_SERIAL_JTAG=y
CONFIG_ESP_CONSOLE_SECONDARY_NONE=y
```

## application/edge_agent/boards/waveshare/waveshare_ESP32_S3_Touch_AMOLED_2_16/sdkconfig.defaults.board
```kconfig
# Waveshare ESP32-S3-Touch-AMOLED-2.16 board defaults
# SoC: ESP32-S3R8, 16 MB QIO Flash + 8 MB Octal PSRAM

CONFIG_ESP_DEFAULT_CPU_FREQ_MHZ_240=y

# Flash: 16 MB, QIO 80 MHz
CONFIG_ESPTOOLPY_FLASHMODE_QIO=y
CONFIG_ESPTOOLPY_FLASHFREQ_80M=y
CONFIG_ESPTOOLPY_FLASHSIZE_16MB=y

# Use the board-specific 16 MB partition table
CONFIG_PARTITION_TABLE_CUSTOM=y
CONFIG_PARTITION_TABLE_CUSTOM_FILENAME="partitions_16MB.csv"

# Octal PSRAM, 80 MHz
CONFIG_SPIRAM=y
CONFIG_SPIRAM_MODE_OCT=y
CONFIG_SPIRAM_SPEED_80M=y
CONFIG_SPIRAM_FETCH_INSTRUCTIONS=y
CONFIG_SPIRAM_RODATA=y

# Board Manager devices
CONFIG_ESP_BOARD_DEV_DISPLAY_LCD_SUPPORT=y
CONFIG_ESP_BOARD_DEV_AUDIO_CODEC_SUPPORT=y

# USB: Serial JTAG
CONFIG_ESP_CONSOLE_USB_SERIAL_JTAG=y
CONFIG_ESP_CONSOLE_SECONDARY_NONE=y

# This board uses GPIO8 as I2S DOUT.
CONFIG_APP_CLAW_UI_HAPTIC_ENABLE=n
```
