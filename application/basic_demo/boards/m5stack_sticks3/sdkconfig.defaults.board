## application/basic_demo/boards/m5stack_sticks3/sdkconfig.defaults.board
```kconfig
# M5Stack StickS3 (ESP32-S3-PICO-1-N8R8) — 8 MB QIO flash + 8 MB Octal PSRAM
CONFIG_ESP_DEFAULT_CPU_FREQ_MHZ_240=y

CONFIG_ESPTOOLPY_FLASHMODE_QIO=y
CONFIG_ESPTOOLPY_FLASHFREQ_80M=y
CONFIG_ESPTOOLPY_FLASHSIZE_8MB=y

CONFIG_PARTITION_TABLE_CUSTOM=y
CONFIG_PARTITION_TABLE_CUSTOM_FILENAME="partitions_8MB.csv"

CONFIG_SPIRAM=y
CONFIG_SPIRAM_MODE_OCT=y
CONFIG_SPIRAM_SPEED_80M=y

CONFIG_ESP_BOARD_PERIPH_I2S_SUPPORT=y
```

## application/edge_agent/boards/Nologo.Tech/xingzhi_395/sdkconfig.defaults.board
```kconfig
CONFIG_ESPTOOLPY_FLASHMODE_QIO=y
CONFIG_ESPTOOLPY_FLASHFREQ_80M=y
CONFIG_ESPTOOLPY_FLASHSIZE_16MB=y
CONFIG_SPIRAM=y
CONFIG_SPIRAM_MODE_HEX=y
CONFIG_SPIRAM_SPEED_200M=y


CONFIG_ESP32P4_SELECTS_REV_LESS_V3=y
CONFIG_ESP_CONSOLE_USB_SERIAL_JTAG=y
CONFIG_ESP_CONSOLE_SECONDARY_NONE=y
CONFIG_ESP_CONSOLE_USB_SERIAL_JTAG_ENABLED=y
CONFIG_ESP_CONSOLE_UART_NUM=-1


#
# Wi-Fi Remote
#
CONFIG_ESP_WIFI_REMOTE_ENABLED=y
CONFIG_ESP_WIFI_REMOTE_IDF_SPECIFIC_ADDED=y
CONFIG_SLAVE_IDF_TARGET_ESP32C5=y
CONFIG_SLAVE_SOC_WIFI_SUPPORTED=y
CONFIG_SLAVE_SOC_WIFI_WAPI_SUPPORT=y
CONFIG_SLAVE_SOC_WIFI_CSI_SUPPORT=y
CONFIG_SLAVE_SOC_WIFI_MESH_SUPPORT=y
CONFIG_SLAVE_SOC_WIFI_NAN_SUPPORT=y
CONFIG_SLAVE_SOC_WIFI_LIGHT_SLEEP_CLK_WIDTH=12
CONFIG_SLAVE_SOC_WIFI_HW_TSF=y
CONFIG_SLAVE_SOC_WIFI_FTM_SUPPORT=y
CONFIG_SLAVE_FREERTOS_UNICORE=y
CONFIG_SLAVE_SOC_WIFI_GCMP_SUPPORT=y
CONFIG_SLAVE_SOC_WIFI_TXOP_SUPPORT=y
CONFIG_SLAVE_IDF_TARGET_ARCH_RISCV=y
CONFIG_SLAVE_SOC_WIFI_HE_SUPPORT=y
CONFIG_SLAVE_SOC_WIFI_MAC_VERSION_NUM=3
CONFIG_SLAVE_SOC_WIFI_SUPPORT_5G=y
CONFIG_SLAVE_IDF_ENV_BRINGUP=y

#
# ESP-Hosted config
#
CONFIG_ESP_HOSTED_CP_TARGET_ESP32C5=y
CONFIG_ESP_HOSTED_PRIV_ENABLE_WIFI_OPTIONS=y

#
# ESP32-C5 is Co-processor Target from Wi-Fi Remote Component
#
CONFIG_ESP_HOSTED_IDF_SLAVE_TARGET="esp32c5"
CONFIG_ESP_HOSTED_P4_DEV_BOARD_NONE=y
CONFIG_ESP_HOSTED_PRIV_SDIO_OPTION=y
CONFIG_ESP_HOSTED_PRIV_SPI_HD_OPTION=y
CONFIG_ESP_HOSTED_SDIO_HOST_INTERFACE=y
```

## application/edge_agent/boards/Wireless-Tag/esp32s3_wt32_sc01_plus/sdkconfig.defaults.board
```kconfig
# Wireless Tag WT32-SC01 Plus board defaults
# SoC: ESP32-S3-WROOM-1-N8R2 (8 MB QIO Flash, 2 MB Quad PSRAM)
# LCD: ST7796 480x320 via native I80 bus (SOC_LCD_I80_SUPPORTED)
# Touch: FT6336U via I2C (lcd_touch + sub_type: i2c)
#
# Note: if your module is N16R8 (16 MB flash, 8 MB Octal PSRAM), replace:
#   CONFIG_ESPTOOLPY_FLASHSIZE_8MB -> _16MB
#   CONFIG_SPIRAM_MODE_QUAD        -> CONFIG_SPIRAM_MODE_OCT

CONFIG_ESP_DEFAULT_CPU_FREQ_MHZ_240=y

# Flash: 8 MB QIO 80 MHz
CONFIG_ESPTOOLPY_FLASHMODE_QIO=y
CONFIG_ESPTOOLPY_FLASHFREQ_80M=y
CONFIG_ESPTOOLPY_FLASHSIZE_16MB=y
CONFIG_PARTITION_TABLE_CUSTOM=y
CONFIG_PARTITION_TABLE_CUSTOM_FILENAME="partitions_16MB.csv"

# Quad PSRAM 2 MB 80 MHz
CONFIG_SPIRAM=y
CONFIG_SPIRAM_MODE_QUAD=y
CONFIG_SPIRAM_SPEED_80M=y

# Disable XIP-from-PSRAM: the global default enables it, but 2 MB PSRAM is not
# large enough to hold flash instructions + heap simultaneously.
# Code executes directly from flash cache instead.
CONFIG_SPIRAM_XIP_FROM_PSRAM=n
CONFIG_SPIRAM_FETCH_INSTRUCTIONS=n
CONFIG_SPIRAM_RODATA=n

# With XIP-from-PSRAM disabled, disabling the SPI flash cache (needed for
# any flash write: NVS, SPIFFS, OTA, …) also makes PSRAM inaccessible.
# If a task's stack is in PSRAM the CPU panics with
#   "assert failed: esp_task_stack_is_sane_cache_disabled"
#
# The global defaults set SPIRAM_MALLOC_ALWAYSINTERNAL=0 (all malloc can go to
# PSRAM) and FREERTOS_TASK_CREATE_ALLOW_EXT_MEM=y (PSRAM stacks allowed).
# Both settings assume XIP-from-PSRAM is active.  Override them here:
#   ALWAYSINTERNAL=65536 → every alloc < 64 kB stays in internal DRAM,
#                          which covers all task stacks.
#   TASK_CREATE_ALLOW_EXT_MEM=n → FreeRTOS refuses to start a task whose
#                          stack landed in PSRAM (fail fast at creation).
CONFIG_SPIRAM_MALLOC_ALWAYSINTERNAL=65536
CONFIG_FREERTOS_TASK_CREATE_ALLOW_EXT_MEM=n

# Enable LCD display (custom I80 device in setup_device.c)
CONFIG_ESP_BOARD_DEV_DISPLAY_LCD_SUPPORT=y

# Enable capacitive touch (FT6336U via lcd_touch + sub_type: i2c)
CONFIG_ESP_BOARD_DEV_LCD_TOUCH_SUPPORT=y
CONFIG_ESP_BOARD_DEV_LCD_TOUCH_SUB_I2C_SUPPORT=y
```

## application/edge_agent/boards/cloudzao/metalio_claw_4/sdkconfig.defaults.board
```kconfig
# Metalio Claw 4: ESP32-P4 with 32 MB flash and octal PSRAM.
CONFIG_ESPTOOLPY_FLASHMODE_QIO=y
CONFIG_ESPTOOLPY_FLASHFREQ_40M=y
CONFIG_ESPTOOLPY_FLASHSIZE_32MB=y

CONFIG_SPIRAM=y
CONFIG_SPIRAM_MODE_HEX=y
CONFIG_SPIRAM_SPEED_200M=y
CONFIG_SPIRAM_MALLOC_RESERVE_INTERNAL=65536
CONFIG_SPIRAM_ALLOW_STACK_EXTERNAL_MEMORY=y

CONFIG_ESP32P4_SELECTS_REV_LESS_V3=y

CONFIG_ESP_CONSOLE_USB_SERIAL_JTAG=y
CONFIG_ESP_CONSOLE_SECONDARY_NONE=y


# The board exposes I2S audio without an external codec control chip.
# dev_audio_codec maps chip=internal+dac_enabled to esp_codec_dev's dummy codec.
CONFIG_CODEC_DUMMY_SUPPORT=y

# ESP32-P4 has no built-in Wi-Fi. Metalio Claw 4 uses ESP-Hosted over SDIO.
CONFIG_ESP_HOSTED_ENABLED=y
CONFIG_SLAVE_IDF_TARGET_ESP32C5=y
CONFIG_ESP_HOSTED_PRIV_ENABLE_WIFI_OPTIONS=y
CONFIG_ESP_HOSTED_P4_DEV_BOARD_NONE=y
CONFIG_ESP_HOSTED_PRIV_SDIO_OPTION=y
CONFIG_ESP_HOSTED_SDIO_HOST_INTERFACE=y
CONFIG_ESP_HOSTED_SDIO_RESET_ACTIVE_HIGH=y
CONFIG_ESP_HOSTED_SDIO_OPTIMIZATION_RX_STREAMING_MODE=y
CONFIG_ESP_HOSTED_SDIO_SLOT_1=y
CONFIG_ESP_HOSTED_SDIO_SLOT=1
CONFIG_ESP_HOSTED_SDIO_4_BIT_BUS=y
CONFIG_ESP_HOSTED_SDIO_BUS_WIDTH=4
CONFIG_ESP_HOSTED_SDIO_CLOCK_FREQ_KHZ=40000
CONFIG_ESP_HOSTED_PRIV_SDIO_PIN_CMD_SLOT_1=50
CONFIG_ESP_HOSTED_PRIV_SDIO_PIN_CLK_SLOT_1=51
CONFIG_ESP_HOSTED_PRIV_SDIO_PIN_D0_SLOT_1=49
CONFIG_ESP_HOSTED_PRIV_SDIO_PIN_D1_4BIT_BUS_SLOT_1=34
CONFIG_ESP_HOSTED_PRIV_SDIO_PIN_D2_4BIT_BUS_SLOT_1=31
CONFIG_ESP_HOSTED_PRIV_SDIO_PIN_D3_4BIT_BUS_SLOT_1=53
CONFIG_ESP_HOSTED_SDIO_GPIO_RESET_SLAVE=54
CONFIG_ESP_HOSTED_SDIO_PIN_CMD=50
CONFIG_ESP_HOSTED_SDIO_PIN_CLK=51
CONFIG_ESP_HOSTED_SDIO_PIN_D0=49
CONFIG_ESP_HOSTED_SDIO_PRIV_PIN_D1_4BIT_BUS=34
CONFIG_ESP_HOSTED_SDIO_PIN_D1=34
CONFIG_ESP_HOSTED_SDIO_PIN_D2=31
CONFIG_ESP_HOSTED_SDIO_PIN_D3=53
CONFIG_ESP_HOSTED_SDIO_TX_Q_SIZE=20
CONFIG_ESP_HOSTED_SDIO_RX_Q_SIZE=20
CONFIG_ESP_HOSTED_SDIO_RESET_DELAY_MS=1500
CONFIG_ESP_HOSTED_SLAVE_RESET_ON_EVERY_HOST_BOOTUP=y
CONFIG_ESP_HOSTED_GPIO_SLAVE_RESET_SLAVE=54


# Compatibility symbols used by some esp-hosted versions.
CONFIG_ESP_SDIO_HOST_INTERFACE=y
CONFIG_SDIO_RESET_ACTIVE_HIGH=y
CONFIG_ESP_SDIO_OPTIMIZATION_RX_STREAMING_MODE=y
CONFIG_ESP_SDIO_4_BIT_BUS=y
CONFIG_ESP_SDIO_BUS_WIDTH=4
CONFIG_ESP_SDIO_CLOCK_FREQ_KHZ=40000
CONFIG_ESP_SDIO_GPIO_RESET_SLAVE=54
CONFIG_ESP_SDIO_PIN_CMD=50
CONFIG_ESP_SDIO_PIN_CLK=51
CONFIG_ESP_SDIO_PIN_D0=49
CONFIG_ESP_SDIO_PIN_D1=34
CONFIG_ESP_SDIO_PIN_D2=31
CONFIG_ESP_SDIO_PIN_D3=53
CONFIG_ESP_SDIO_TX_Q_SIZE=20
CONFIG_ESP_SDIO_RX_Q_SIZE=20
CONFIG_ESP_GPIO_SLAVE_RESET_SLAVE=54

CONFIG_LV_COLOR_DEPTH_24=y
CONFIG_EMOTE_RGB888_SUPPORT=y
```

## application/edge_agent/boards/community/anyboard/sdkconfig.defaults.board
```kconfig
CONFIG_ESP_DEFAULT_CPU_FREQ_MHZ_240=y
CONFIG_ESPTOOLPY_FLASHMODE_QIO=y
CONFIG_ESPTOOLPY_FLASHFREQ_80M=y
CONFIG_ESPTOOLPY_FLASHSIZE_8MB=y
CONFIG_SPIRAM=y
CONFIG_SPIRAM_MODE_OCT=y
CONFIG_SPIRAM_SPEED_80M=y
CONFIG_ESP_VIDEO_ENABLE_USB_UVC_VIDEO_DEVICE=y
CONFIG_USB_HOST_CONTROL_TRANSFER_MAX_SIZE=1024
CONFIG_USB_UVC_VIDEO_DEVICE_URB_SIZE=4096
CONFIG_APP_CLAW_LUA_MODULE_CAMERA=y
CONFIG_APP_CLAW_LUA_MODULE_VISION=y
CONFIG_APP_CLAW_LUA_MODULE_IMU=y
CONFIG_LUA_MODULE_IMU_CHIP_BMI270=y
CONFIG_ESP_BOARD_DEV_AUDIO_CODEC_SUPPORT=y
CONFIG_APP_CLAW_LUA_MODULE_AUDIO=y
CONFIG_ESP_CONSOLE_USB_SERIAL_JTAG=y
CONFIG_ESP_CONSOLE_SECONDARY_NONE=y
```

## application/edge_agent/boards/dfrobot/dfrobot_ai_camera/sdkconfig.defaults.board
```kconfig
CONFIG_ESP_DEFAULT_CPU_FREQ_MHZ_240=y

# DFR1154: 16 MB QIO flash @ 80 MHz
CONFIG_ESPTOOLPY_FLASHMODE_QIO=y
CONFIG_ESPTOOLPY_FLASHFREQ_80M=y
CONFIG_ESPTOOLPY_FLASHSIZE_16MB=y

# DFR1154: 8 MB octal PSRAM @ 80 MHz
CONFIG_SPIRAM=y
CONFIG_SPIRAM_MODE_OCT=y
CONFIG_SPIRAM_SPEED_80M=y

# Speaker: internal/dummy codec over I2S TX → MAX98357
CONFIG_CODEC_DUMMY_SUPPORT=y
#CONFIG_CODEC_DATA_ADC_SUPPORT=y
CONFIG_ESP_BOARD_PERIPH_I2S_SUPPORT=y

# Camera: OV3660 over DVP 8-bit
CONFIG_ESP_BOARD_DEV_CAMERA_SUPPORT=y
CONFIG_ESP_VIDEO_ENABLE_DVP_VIDEO_DEVICE=y
CONFIG_CAMERA_OV3660=y

# USB: Serial JTAG
CONFIG_ESP_CONSOLE_USB_SERIAL_JTAG=y
CONFIG_ESP_CONSOLE_SECONDARY_NONE=y
```

## application/edge_agent/boards/dfrobot/dfrobot_firebeetle_2_ESP32_C5_for_display/sdkconfig.defaults.board
```kconfig
CONFIG_ESP_DEFAULT_CPU_FREQ_MHZ_240=y

# FireBeetle 2 ESP32-C5 (DFR1222): 16 MB QIO flash @ 80 MHz
CONFIG_ESPTOOLPY_FLASHMODE_QIO=y
CONFIG_ESPTOOLPY_FLASHFREQ_80M=y
CONFIG_ESPTOOLPY_FLASHSIZE_16MB=y

CONFIG_PARTITION_TABLE_CUSTOM=y
CONFIG_PARTITION_TABLE_CUSTOM_FILENAME="partitions_16MB.csv"

# N16R8: 8 MB quad PSRAM
CONFIG_SPIRAM=y
CONFIG_SPIRAM_MODE_QUAD=y
CONFIG_SPIRAM_SPEED_80M=y

# Quad PSRAM: XIP from PSRAM causes CPU_LOCKUP when SPI/DMA starts (see m5stack_cores3).
CONFIG_SPIRAM_XIP_FROM_PSRAM=n
CONFIG_SPIRAM_FETCH_INSTRUCTIONS=n
CONFIG_SPIRAM_RODATA=n
CONFIG_FREERTOS_TASK_CREATE_ALLOW_EXT_MEM=n

# Display: GDI LCD over SPI
CONFIG_ESP_BOARD_DEV_DISPLAY_LCD_SUPPORT=y

# USB: Serial JTAG
CONFIG_ESP_CONSOLE_USB_SERIAL_JTAG=y
CONFIG_ESP_CONSOLE_SECONDARY_NONE=y
```

## application/edge_agent/boards/dfrobot/dfrobot_firebeetle_2_ESP32_P4_for_camera/sdkconfig.defaults.board
```kconfig
CONFIG_ESPTOOLPY_FLASHMODE_QIO=y
CONFIG_ESPTOOLPY_FLASHFREQ_80M=y
CONFIG_ESPTOOLPY_FLASHSIZE_16MB=y

# FireBeetle 2 ESP32-P4: 32 MB PSRAM
CONFIG_SPIRAM=y
CONFIG_SPIRAM_MODE_HEX=y
CONFIG_SPIRAM_SPEED_200M=y

# Open Audio 
CONFIG_ESP_BOARD_DEV_AUDIO_CODEC_SUPPORT=y
CONFIG_APP_CLAW_LUA_MODULE_AUDIO=y


# Camera: OV5647 on MIPI-CSI (RPi-compatible connector)
CONFIG_CAMERA_OV5647=y
CONFIG_CAMERA_OV5647_AUTO_DETECT_MIPI_INTERFACE_SENSOR=y
CONFIG_CAMERA_OV5647_MIPI_RAW8_800X800_50FPS=y
CONFIG_CAMERA_OV5647_MIPI_IF_FORMAT_INDEX_DEFAULT=2
CONFIG_CAMERA_OV5647_DEFAULT_IPA_JSON_CONFIGURATION_FILE=y
CONFIG_ESP_VIDEO_ENABLE_ISP_PIPELINE_CONTROLLER=y

# USB: Serial JTAG
CONFIG_ESP_CONSOLE_USB_SERIAL_JTAG=y
CONFIG_ESP_CONSOLE_SECONDARY_NONE=y

# P4 rev selection (matches other P4 boards in this repo)
CONFIG_ESP32P4_SELECTS_REV_LESS_V3=y
```

## application/edge_agent/boards/dfrobot/dfrobot_firebeetle_2_ESP32_S3/sdkconfig.defaults.board
```kconfig
CONFIG_ESP_DEFAULT_CPU_FREQ_MHZ_240=y

# FireBeetle 2 ESP32-S3 (N16R8): 16 MB QIO flash @ 80 MHz
CONFIG_ESPTOOLPY_FLASHMODE_QIO=y
CONFIG_ESPTOOLPY_FLASHFREQ_80M=y
CONFIG_ESPTOOLPY_FLASHSIZE_16MB=y

# 8 MB octal PSRAM
CONFIG_SPIRAM=y
CONFIG_SPIRAM_MODE_OCT=y
CONFIG_SPIRAM_SPEED_80M=y

# Camera: OV3660 over DVP 8-bit
CONFIG_ESP_BOARD_DEV_CAMERA_SUPPORT=y
CONFIG_ESP_VIDEO_ENABLE_DVP_VIDEO_DEVICE=y
CONFIG_CAMERA_OV3660=y
CONFIG_CAMERA_OV3660_AUTO_DETECT_DVP_INTERFACE_SENSOR=y
# 1280x720 JPEG default needs too much internal DMA RAM alongside display/LVGL on N16R8.
# CONFIG_CAMERA_OV3660_DVP_JPEG_1280X720_12FPS is not set
CONFIG_CAMERA_OV3660_DVP_YUV422_YUYV_640X480_10FPS=y
# CONFIG_CAMERA_OV3660_DVP_DEFAULT_FMT_JPEG_1280X720_12FPS is not set
CONFIG_CAMERA_OV3660_DVP_DEFAULT_FMT_YUV422_YUYV_640X480_10FPS=y
CONFIG_CAMERA_OV3660_DVP_IF_FORMAT_INDEX_DEFAULT=3

# Display: DFR1092 (ST7365P) over SPI / GDI
CONFIG_ESP_BOARD_DEV_DISPLAY_LCD_SUPPORT=y

# USB: Serial JTAG
CONFIG_ESP_CONSOLE_USB_SERIAL_JTAG=y
CONFIG_ESP_CONSOLE_SECONDARY_NONE=y
```

## application/edge_agent/boards/espressif/esp32_S3_DevKitC_1/sdkconfig.defaults.board
```kconfig
CONFIG_ESP_DEFAULT_CPU_FREQ_MHZ_240=y
CONFIG_ESPTOOLPY_FLASHMODE_QIO=y
CONFIG_ESPTOOLPY_FLASHFREQ_80M=y
CONFIG_ESPTOOLPY_FLASHSIZE_8MB=y
CONFIG_SPIRAM=y
CONFIG_SPIRAM_MODE_OCT=y
CONFIG_SPIRAM_SPEED_80M=y
CONFIG_APP_CLAW_LUA_MODULE_LCD=y
```

## application/edge_agent/boards/espressif/esp32_S3_DevKitC_1_breadboard/sdkconfig.defaults.board
```kconfig
CONFIG_ESP_DEFAULT_CPU_FREQ_MHZ_240=y
CONFIG_ESPTOOLPY_FLASHMODE_QIO=y
CONFIG_ESPTOOLPY_FLASHFREQ_80M=y
CONFIG_ESPTOOLPY_FLASHSIZE_8MB=y
CONFIG_PARTITION_TABLE_CUSTOM=y
CONFIG_PARTITION_TABLE_CUSTOM_FILENAME="partitions_8MB.csv"
CONFIG_SPIRAM=y
CONFIG_SPIRAM_MODE_OCT=y
CONFIG_SPIRAM_SPEED_80M=y

CONFIG_ESP_BOARD_PERIPH_I2S_SUPPORT=y
CONFIG_ESP_VIDEO_ENABLE_USB_UVC_VIDEO_DEVICE=y
CONFIG_USB_HOST_CONTROL_TRANSFER_MAX_SIZE=1024
CONFIG_USB_UVC_VIDEO_DEVICE_URB_SIZE=4096
CONFIG_APP_CLAW_LUA_MODULE_ENVIRONMENTAL_SENSOR=y
CONFIG_LUA_MODULE_ENVIRONMENTAL_SENSOR_BACKEND_BME690=n
CONFIG_LUA_MODULE_ENVIRONMENTAL_SENSOR_BACKEND_DHT=y
```

## application/edge_agent/boards/espressif/esp32_p4_function_ev/sdkconfig.defaults.board
```kconfig
CONFIG_ESPTOOLPY_FLASHMODE_QIO=y
CONFIG_ESPTOOLPY_FLASHFREQ_80M=y
CONFIG_ESPTOOLPY_FLASHSIZE_16MB=y
CONFIG_SPIRAM=y
CONFIG_SPIRAM_MODE_HEX=y
CONFIG_SPIRAM_SPEED_200M=y

#
# Camera Sensor Configuration
#
CONFIG_CAMERA_SC2336=y
CONFIG_CAMERA_SC2336_AUTO_DETECT_MIPI_INTERFACE_SENSOR=y
CONFIG_CAMERA_SC2336_MIPI_RAW8_1280X720_30FPS=y
CONFIG_CAMERA_SC2336_MIPI_IF_FORMAT_INDEX_DEFAULT=9
CONFIG_CAMERA_SC2336_DVP_RAW10_1280X720_30FPS=y
CONFIG_CAMERA_SC2336_DVP_IF_FORMAT_INDEX_DEFAULT=0
CONFIG_CAMERA_SC2336_ABSOLUTE_GAIN_LIMIT=66016
CONFIG_CAMERA_SC2336_DIG_GAIN_PRIORITY=y
CONFIG_CAMERA_SC2336_DEFAULT_IPA_JSON_CONFIGURATION_FILE=y
CONFIG_ESP_VIDEO_ENABLE_ISP_PIPELINE_CONTROLLER=y

CONFIG_ESP32P4_SELECTS_REV_LESS_V3=y
```

## application/edge_agent/boards/espressif/esp32_p4_nano/sdkconfig.defaults.board
```kconfig
CONFIG_ESPTOOLPY_FLASHMODE_QIO=y
CONFIG_ESPTOOLPY_FLASHFREQ_80M=y
CONFIG_ESPTOOLPY_FLASHSIZE_16MB=y
CONFIG_SPIRAM=y
CONFIG_SPIRAM_MODE_HEX=y
CONFIG_SPIRAM_SPEED_200M=y

#
# USB Serial JTAG Console Configuration
#
CONFIG_ESP32P4_SELECTS_REV_LESS_V3=y
# CONFIG_ESP_CONSOLE_USB_SERIAL_JTAG is not set
CONFIG_ESP_CONSOLE_UART=y
CONFIG_ESP_CONSOLE_UART_NUM=0
CONFIG_ESP_CONSOLE_SECONDARY_NONE=y

#
# Audio Configuration for ES8311 codec
#
CONFIG_ESP_CODEC_DEV_ES8311_USE_DEFAULT_CALIB_IN_FLASH=y
```

## application/edge_agent/boards/espressif/esp32_s31_korvo1/sdkconfig.defaults.board
```kconfig
CONFIG_CODEC_ES8389_SUPPORT=y

CONFIG_PARTITION_TABLE_CUSTOM=y
CONFIG_ESPTOOLPY_FLASHSIZE_8MB=y
CONFIG_SPIRAM=y
CONFIG_SPIRAM_MODE_OCT=y
CONFIG_SPIRAM_SPEED_200M=y
CONFIG_SPIRAM_XIP_FROM_PSRAM=y

# This configuration is temporarily disabled due to an issue in IDF 6.1.
CONFIG_SPIRAM_ALLOW_BSS_SEG_EXTERNAL_MEMORY=n
CONFIG_SPIRAM_ALLOW_NOINIT_SEG_EXTERNAL_MEMORY=n

#
# Camera Sensor Configuration
#
CONFIG_CAMERA_OV3660=y
CONFIG_CAMERA_OV3660_DVP_JPEG_1280X720_12FPS=y
CONFIG_CAM_CTRL_SPI_ENABLE=n
CONFIG_ESP_VIDEO_ENABLE_DVP_VIDEO_DEVICE=y
CONFIG_ESP_VIDEO_ENABLE_MIPI_CSI_VIDEO_DEVICE=n
CONFIG_ESP_VIDEO_ENABLE_SPI_VIDEO_DEVICE=n
CONFIG_ESP_VIDEO_ENABLE_USB_UVC_VIDEO_DEVICE=n
CONFIG_ESP_VIDEO_ENABLE_SWAP_BYTE=n
CONFIG_ESP_VIDEO_ENABLE_SWAP_BYTE_RISCV=n

CONFIG_APP_CLAW_LUA_DRIVER_ADC=n
```

## application/edge_agent/boards/espressif/esp_SensairShuttle/sdkconfig.defaults.board
```kconfig
CONFIG_ESPTOOLPY_FLASHMODE_QIO=y
CONFIG_ESPTOOLPY_FLASHFREQ_80M=y
CONFIG_ESPTOOLPY_FLASHSIZE_16MB=y
CONFIG_SPIRAM=y
CONFIG_SPIRAM_MODE_QUAD=y
CONFIG_SPIRAM_SPEED_80M=y

CONFIG_CODEC_DUMMY_SUPPORT=y
CONFIG_CODEC_DATA_ADC_SUPPORT=y
CONFIG_ESP_CONSOLE_USB_SERIAL_JTAG=y
CONFIG_ESP_CONSOLE_SECONDARY_NONE=y
CONFIG_APP_CLAW_LUA_MODULE_IMU=y
CONFIG_LUA_MODULE_IMU_CHIP_BMI270=y
CONFIG_APP_CLAW_LUA_MODULE_MAGNETOMETER=y
CONFIG_APP_CLAW_LUA_MODULE_ENVIRONMENTAL_SENSOR=y
CONFIG_LUA_MODULE_ENVIRONMENTAL_SENSOR_BACKEND_BME690=y
CONFIG_LUA_MODULE_ENVIRONMENTAL_SENSOR_BACKEND_DHT=n
CONFIG_ESP_CONSOLE_USB_SERIAL_JTAG_ENABLED=y
CONFIG_ESP_CONSOLE_UART_NUM=-1
```
