## components/lua_modules/lua_module_environmental_sensor/Kconfig
```kconfig
menu "Lua Environmental Sensor Module"

    config LUA_MODULE_ENVIRONMENTAL_SENSOR_BACKEND_BME690
        bool "Enable BME690 backend"
        default y
        help
            Build the environmental sensor Lua module with the Bosch BME690
            backend.

    config LUA_MODULE_ENVIRONMENTAL_SENSOR_BACKEND_DHT
        bool "Enable DHT backend"
        default y
        help
            Build the environmental sensor Lua module with the DHT-family
            single-wire backend.

endmenu
```

## components/lua_modules/lua_module_thread/test_apps/thread_smoke_test/sdkconfig.defaults
```kconfig
CONFIG_PARTITION_TABLE_CUSTOM=y
CONFIG_PARTITION_TABLE_CUSTOM_FILENAME="partitions.csv"
CONFIG_PARTITION_TABLE_FILENAME="partitions.csv"
CONFIG_ESPTOOLPY_FLASHSIZE_4MB=y
CONFIG_ESPTOOLPY_FLASHSIZE="4MB"
CONFIG_LOG_DEFAULT_LEVEL_INFO=y
CONFIG_UNITY_ENABLE_FLOAT=y
CONFIG_FATFS_LFN_STACK=y
CONFIG_FATFS_MAX_LFN=255
CONFIG_ESP_TASK_WDT_EN=n
CONFIG_ESP_MAIN_TASK_STACK_SIZE=16384
```

## components/lua_modules/lua_module_vision/Kconfig
```kconfig
menu "Lua Vision Module"
    depends on APP_CLAW_CAP_LUA
    depends on APP_CLAW_LUA_MODULE_VISION
    depends on ESP_BOARD_DEV_CAMERA_SUPPORT

    config LUA_MODULE_VISION_MOTION_DETECT
        bool "Enable motion_detect Lua module"
        default y
        help
            Build and register the lightweight motion_detect Lua module. This is
            the default vision submodule and does not require ESPDet model
            runtime support.

    config LUA_MODULE_VISION_ESPDET
        bool "Enable espdet Lua module"
        default n
        help
            Build and register the ESP-DL-backed espdet Lua module for running
            ESPDet object detection models from Lua. Enable this only on builds
            that need ESPDet model inference.

endmenu
```

## framework/lua_modules/driver_touch/Kconfig
```kconfig
menu "Lua Touch Driver"

    config LUA_DRIVER_TOUCH_DEFAULT_THRESHOLD_MILLI
        int "Default touch threshold in permille"
        default 15
        range 1 500
        help
            Relative touch threshold in permille. For example, 15 means 1.5%.

endmenu
```
