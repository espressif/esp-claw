## application/edge_agent/boards/waveshare/waveshare_esp32_s3_geek/sdkconfig.defaults.board
```kconfig
# Waveshare ESP32-S3-GEEK — ESP32-S3R2
# 16 MB external QIO NOR flash (W25Q128) + 2 MB on-chip Quad PSRAM
CONFIG_ESP_DEFAULT_CPU_FREQ_MHZ_240=y

CONFIG_ESPTOOLPY_FLASHMODE_QIO=y
CONFIG_ESPTOOLPY_FLASHFREQ_80M=y
CONFIG_ESPTOOLPY_FLASHSIZE_16MB=y

# Partition table is auto-selected from partitions_16MB.csv
# by tools/cmake/flash_partition_defaults.cmake.

# On-chip 2 MB Quad PSRAM (R2 variant — not octal)
CONFIG_SPIRAM=y
CONFIG_SPIRAM_MODE_QUAD=y
CONFIG_SPIRAM_SPEED_80M=y

# Disable XIP-from-PSRAM: 2 MB is not enough to hold both flash instructions
# (~1.5 MB) and rodata (~700 KB). Instructions are fetched from flash cache
# instead (32 KB I-cache on ESP32-S3), with a small performance trade-off.
CONFIG_SPIRAM_XIP_FROM_PSRAM=n
CONFIG_SPIRAM_FETCH_INSTRUCTIONS=n
CONFIG_SPIRAM_RODATA=n

# Quad PSRAM cannot keep the stack accessible while cache is disabled for a flash
# transaction. Force FreeRTOS to allocate task stacks from internal RAM so claw
# tasks tagged CLAW_TASK_STACK_PREFER_PSRAM fall back to internal memory.
CONFIG_FREERTOS_TASK_CREATE_ALLOW_EXT_MEM=n
CONFIG_MDNS_TASK_CREATE_FROM_INTERNAL=y

# USB: Serial JTAG
CONFIG_ESP_CONSOLE_USB_SERIAL_JTAG=y
CONFIG_ESP_CONSOLE_SECONDARY_NONE=y
CONFIG_ESP_CONSOLE_USB_SERIAL_JTAG_ENABLED=y
```

## application/mcp_server_point/main/Kconfig.projbuild
```kconfig
menu "App Config"

menu "Default Wi-Fi Settings"

    config APP_WIFI_SSID
        string "Default Wi-Fi SSID"
        default ""
        help
            Default Wi-Fi SSID used to populate app settings.

    config APP_WIFI_PASSWORD
        string "Default Wi-Fi password"
        default ""
        help
            Default Wi-Fi password used to populate app settings.

    config APP_WIFI_AP_SSID_PREFIX
        string "Provisioning AP SSID prefix"
        default "esp-claw"
        help
            Prefix used to build the unique provisioning AP SSID. The full
            SSID is "<prefix>-<MAC[3..5]>" (e.g. esp-claw-84AEE5).

    config APP_WIFI_AP_CHANNEL
        int "Provisioning AP channel"
        range 1 13
        default 1
        help
            Channel used by the provisioning SoftAP.

    config APP_WIFI_AP_MAX_CONN
        int "Provisioning AP max connections"
        range 1 10
        default 4
        help
            Maximum number of concurrent stations on the provisioning AP.

    config APP_WIFI_MAX_RETRY
        int "STA max retries before AP fallback"
        range 1 20
        default 5
        help
            After this many consecutive STA connection failures the device
            falls back to pure AP mode and waits for the user to provision
            new credentials.

endmenu

endmenu
```

## applications/edge_agent/boards/dfrobot/dfrobot_k10/sdkconfig.defaults.board
```kconfig
CONFIG_ESP_DEFAULT_CPU_FREQ_MHZ_240=y

# DFRobot K10: 16 MB QIO flash @ 80 MHz
CONFIG_ESPTOOLPY_FLASHMODE_QIO=y
CONFIG_ESPTOOLPY_FLASHFREQ_80M=y
CONFIG_ESPTOOLPY_FLASHSIZE_16MB=y

# DFRobot K10: 8 MB octal PSRAM @ 80 MHz
CONFIG_SPIRAM=y
CONFIG_SPIRAM_MODE_OCT=y
CONFIG_SPIRAM_SPEED_80M=y

# K10 audio output: internal/dummy codec over I2S TX (stereo on wire).
CONFIG_CODEC_DUMMY_SUPPORT=y

# K10 microphone: ES7243E on I2S0 STD RX (Philips stereo).
CONFIG_CODEC_ES7243E_SUPPORT=y

# K10 camera: GC2145 over DVP 8-bit
CONFIG_ESP_BOARD_DEV_CAMERA_SUPPORT=y
CONFIG_ESP_VIDEO_ENABLE_DVP_VIDEO_DEVICE=y
CONFIG_CAMERA_GC2145=y

# SCI Sensor
CONFIG_APP_CLAW_LUA_MODULE_SCI=y

CONFIG_LOG_MAXIMUM_LEVEL_DEBUG=y
CONFIG_LOG_DEFAULT_LEVEL_INFO=y

# USB: Serial JTAG
CONFIG_ESP_CONSOLE_USB_SERIAL_JTAG=y
CONFIG_ESP_CONSOLE_SECONDARY_NONE=y
```

## applications/edge_agent/boards/espressif/esp32_p4_eye/sdkconfig.defaults.board
```kconfig
CONFIG_ESPTOOLPY_FLASHMODE_QIO=y
CONFIG_ESPTOOLPY_FLASHFREQ_80M=y
CONFIG_ESPTOOLPY_FLASHSIZE_16MB=y
CONFIG_SPIRAM=y
CONFIG_SPIRAM_MODE_HEX=y
CONFIG_SPIRAM_SPEED_200M=y

#
# Camera Sensor Configuration
#
CONFIG_CAMERA_OV2710=y
CONFIG_ESP_VIDEO_ENABLE_ISP_PIPELINE_CONTROLLER=y

CONFIG_ESP32P4_SELECTS_REV_LESS_V3=y
CONFIG_ESP_CONSOLE_USB_SERIAL_JTAG=y
CONFIG_ESP_CONSOLE_SECONDARY_NONE=y
CONFIG_ESP_CONSOLE_USB_SERIAL_JTAG_ENABLED=y
CONFIG_ESP_CONSOLE_UART_NUM=-1
CONFIG_APP_CLAW_LUA_MODULE_KNOB=y
#
# ESP-Hosted: Select P4-EYE board for correct C6 SDIO pin mapping
#
CONFIG_ESP32P4_EYE_C6_BOARD=y
```

## applications/edge_agent/boards/espressif/esp_Ditto/sdkconfig.defaults.board
```kconfig
CONFIG_ESPTOOLPY_FLASHMODE_QIO=y
CONFIG_ESPTOOLPY_FLASHFREQ_80M=y
CONFIG_ESPTOOLPY_FLASHSIZE_16MB=y
CONFIG_SPIRAM=y
CONFIG_SPIRAM_MODE_OCT=y
CONFIG_SPIRAM_SPEED_80M=y

CONFIG_CODEC_DUMMY_SUPPORT=y
CONFIG_CODEC_DATA_ADC_SUPPORT=y
CONFIG_APP_CLAW_LUA_MODULE_IMU=y
CONFIG_LUA_MODULE_IMU_CHIP_BMI270=y
CONFIG_APP_CLAW_LUA_MODULE_MAGNETOMETER=y
CONFIG_LUA_MODULE_MAGNETOMETER_CHIP_BMM150=y
CONFIG_APP_CLAW_LUA_MODULE_FUEL_GAUGE=y
CONFIG_ESP_CONSOLE_USB_SERIAL_JTAG=y
CONFIG_ESP_CONSOLE_SECONDARY_NONE=y
CONFIG_ESP_CONSOLE_USB_SERIAL_JTAG_ENABLED=y
CONFIG_ESP_CONSOLE_UART_NUM=-1

CONFIG_CAMERA_BF3901=y
CONFIG_CAMERA_BF3901_SPI_RGB565_240X320_15FPS=y
CONFIG_CAMERA_BF3901_SPI_YUV422_240X320_15FPS=n
CONFIG_CAM_CTLR_SPI_ISR_CACHE_SAFE=n

# disable hardware acceleration for save gdma channels
CONFIG_MBEDTLS_HARDWARE_AES=n
CONFIG_MBEDTLS_HARDWARE_MPI=n
CONFIG_MBEDTLS_HARDWARE_SHA=n
CONFIG_MBEDTLS_HARDWARE_ECDSA_VERIFY=n
```

## applications/edge_agent/boards/espressif/esp_sparkbot/sdkconfig.defaults.board
```kconfig
CONFIG_ESP_DEFAULT_CPU_FREQ_MHZ_240=y
CONFIG_ESPTOOLPY_FLASHMODE_DIO=y
CONFIG_ESPTOOLPY_FLASHFREQ_80M=y
CONFIG_ESPTOOLPY_FLASHSIZE_16MB=y
CONFIG_PARTITION_TABLE_CUSTOM=y
CONFIG_PARTITION_TABLE_CUSTOM_FILENAME="partitions_16MB.csv"

CONFIG_SPIRAM=y
CONFIG_SPIRAM_MODE_OCT=y
CONFIG_SPIRAM_SPEED_80M=y

# USB: Serial JTAG
CONFIG_ESP_CONSOLE_USB_SERIAL_JTAG=y
CONFIG_ESP_CONSOLE_USB_SERIAL_JTAG_ENABLED=y
CONFIG_ESP_CONSOLE_SECONDARY_NONE=y
CONFIG_ESP_CONSOLE_UART_NUM=-1

CONFIG_ESP_BOARD_PERIPH_I2S_SUPPORT=y
CONFIG_CODEC_DUMMY_SUPPORT=y
CONFIG_CODEC_DATA_ADC_SUPPORT=y
CONFIG_APP_CLAW_LUA_MODULE_LCD=y
CONFIG_APP_CLAW_LUA_MODULE_IMU=y
CONFIG_LUA_MODULE_IMU_CHIP_BMI270=y

# Camera: OV3660 over DVP (SCCB 0x3C, chip id 0x3660, XCLK 20 MHz)
CONFIG_ESP_BOARD_DEV_CAMERA_SUPPORT=y
CONFIG_ESP_VIDEO_ENABLE_DVP_VIDEO_DEVICE=y
CONFIG_CAMERA_OV3660=y
CONFIG_CAMERA_OV3660_AUTO_DETECT_DVP_INTERFACE_SENSOR=y
CONFIG_CAMERA_OV3660_DVP_YUV422_YUYV_640X480_10FPS=y
CONFIG_CAMERA_OV3660_DVP_DEFAULT_FMT_YUV422_YUYV_640X480_10FPS=y
CONFIG_APP_CLAW_LUA_MODULE_CAMERA=y
```

## applications/edge_agent/boards/lilygo/lilygo_t_display_p4_v1/sdkconfig.defaults.board
```kconfig
CONFIG_APP_CLAW_ENABLE_EMOTE=y
CONFIG_APP_CLAW_LUA_MODULE_AUDIO=y

CONFIG_ESP_BOARD_PERIPH_I2S_SUPPORT=y
CONFIG_ESP_BOARD_DEV_DISPLAY_LCD_SUPPORT=y
CONFIG_ESP_BOARD_DEV_AUDIO_CODEC_SUPPORT=y

CONFIG_ESPTOOLPY_FLASHSIZE_16MB=y
CONFIG_ESPTOOLPY_FLASHFREQ_120M=y
CONFIG_BOOTLOADER_FLASH_DC_AWARE=y
CONFIG_SPIRAM=y
CONFIG_SPIRAM_MODE_HEX=y
CONFIG_SPIRAM_SPEED_200M=y
CONFIG_CACHE_L2_CACHE_256KB=y
CONFIG_CACHE_L2_CACHE_LINE_128B=y

CONFIG_FREERTOS_TIMER_TASK_STACK_DEPTH=8192
CONFIG_FREERTOS_HZ=1000

CONFIG_CAMERA_SC2336=y
CONFIG_CAMERA_SC2336_MIPI_RAW8_1280x720_30FPS=n
CONFIG_CAMERA_SC2336_MIPI_RAW10_1280x720_30FPS=y

CONFIG_CAMERA_OV2710=y
CONFIG_CAMERA_OV2710_MIPI_RAW10_1280X720_25FPS=y
CONFIG_CAMERA_OV2710_MIPI_RAW10_1920X1080_25FPS=n

CONFIG_CAMERA_OV5645=y
CONFIG_CAMERA_OV5645_MIPI_RGB565_1280X960_30FPS=y
CONFIG_CAMERA_OV5645_MIPI_YUV422_1280X960_30FPS=n

CONFIG_ETHERNET_PHY_IP101=y
CONFIG_ETHERNET_PHY_RST_GPIO=-1

CONFIG_SLAVE_IDF_TARGET_ESP32C6=y
CONFIG_ESP_HOSTED_SDIO_GPIO_RESET_SLAVE=100
```

## applications/edge_agent/boards/lilygo/lilygo_t_display_s3/sdkconfig.defaults.board
```kconfig
# LilyGO T-Display-S3 board defaults
# ESP32-S3R8: 16 MB Flash (QIO 80 MHz) + 8 MB OPI PSRAM

CONFIG_ESP_DEFAULT_CPU_FREQ_MHZ_240=y

# Flash: 16 MB, QIO 80 MHz
CONFIG_ESPTOOLPY_FLASHMODE_QIO=y
CONFIG_ESPTOOLPY_FLASHFREQ_80M=y
CONFIG_ESPTOOLPY_FLASHSIZE_16MB=y

# Use the 16 MB partition table
CONFIG_PARTITION_TABLE_CUSTOM=y
CONFIG_PARTITION_TABLE_CUSTOM_FILENAME="partitions_16MB.csv"

# OPI PSRAM, 80 MHz
CONFIG_SPIRAM=y
CONFIG_SPIRAM_MODE_OCT=y
CONFIG_SPIRAM_SPEED_80M=y

# Keep display_lcd-dependent code paths enabled even though this board uses
# a custom i80 LCD device implementation instead of the built-in generator.
CONFIG_ESP_BOARD_DEV_DISPLAY_LCD_SUPPORT=y

# USB: Serial JTAG
CONFIG_ESP_CONSOLE_USB_SERIAL_JTAG=y
CONFIG_ESP_CONSOLE_SECONDARY_NONE=y
```

## applications/edge_agent/boards/rockbase-iot/nm_cyd_c5/sdkconfig.defaults.board
```kconfig
# Board specific defaults for NM-CYD-C5 (ESP32-C5, 16 MB flash, 8 MB PSRAM).

CONFIG_IDF_TARGET="esp32c5"
CONFIG_ESP_DEFAULT_CPU_FREQ_MHZ_240=y

# Flash: 16 MB DIO 80 MHz
CONFIG_ESPTOOLPY_FLASHMODE_DIO=y
CONFIG_ESPTOOLPY_FLASHFREQ_80M=y
CONFIG_ESPTOOLPY_FLASHSIZE_16MB=y
CONFIG_PARTITION_TABLE_CUSTOM=y
CONFIG_PARTITION_TABLE_CUSTOM_FILENAME="partitions_16MB.csv"

# PSRAM: 8 MB quad 80 MHz. ESP32-C5 does not use ESP32-S3 OPI PSRAM options.
CONFIG_SPIRAM=y
CONFIG_SPIRAM_MODE_QUAD=y
CONFIG_SPIRAM_SPEED_80M=y
CONFIG_SPIRAM_TYPE_AUTO=y

# USB: Serial JTAG
CONFIG_ESP_CONSOLE_USB_SERIAL_JTAG=y
CONFIG_ESP_CONSOLE_SECONDARY_NONE=y
```

## components/claw_capabilities/cap_system/Kconfig
```kconfig
menu "Claw System Capability"

config CLAW_CAP_SYSTEM_DEBUG_LOGS
    bool "Enable cap_system debug logs"
    default n
    help
        Print the JSON payload returned by cap_system calls. This is useful
        for debugging the actual information collected from the device.

endmenu
```

## components/claw_modules/claw_core/Kconfig
```kconfig
menu "ESP-Claw Core"

choice CLAW_CORE_STAGE_VERBOSITY
    prompt "Agent stage notification verbosity"
    default CLAW_CORE_STAGE_VERBOSITY_SIMPLE
    help
        Controls how much detail is forwarded to IM channels during agent execution.

config CLAW_CORE_STAGE_VERBOSITY_SIMPLE
    bool "Simple"
    help
        Send only essential updates: tool names being invoked.

config CLAW_CORE_STAGE_VERBOSITY_VERBOSE
    bool "Verbose"
    help
        Include tool arguments preview and iteration round in addition to tool
        names. Useful for debugging and power users.

endchoice

endmenu
```

## components/claw_modules/claw_core/test_apps/core_interrupt_test/sdkconfig.defaults
```kconfig
# For IDF 5.0
CONFIG_ESP_DEFAULT_CPU_FREQ_MHZ_240=y
CONFIG_FREERTOS_HZ=1000
CONFIG_ESP_TASK_WDT_EN=n
CONFIG_LWIP_NETIF_LOOPBACK=y
CONFIG_LWIP_LOOPBACK_MAX_PBUFS=8
```

## components/claw_modules/claw_event_router/test_apps/event_router_cli_test/sdkconfig.defaults
```kconfig
CONFIG_ESPTOOLPY_FLASHMODE_QIO=y
CONFIG_ESPTOOLPY_FLASHFREQ_120M=y
CONFIG_ESPTOOLPY_FLASHSIZE_16MB=y
CONFIG_PARTITION_TABLE_CUSTOM=y
CONFIG_PARTITION_TABLE_CUSTOM_FILENAME="partitions.csv"
CONFIG_ESP_CONSOLE_UART_DEFAULT=y
```

## components/claw_modules/claw_manager/Kconfig
```kconfig
menu "Claw Manager"

    config CLAW_AGENT_MGR_MAX_SUBAGENTS
        int "Maximum concurrent subagents"
        default 3
        range 1 8
        help
            Maximum number of live subagent runtime slots managed by claw_agent_mgr.

endmenu
```

## components/claw_modules/claw_manager/test_apps/agent_mgr_runtime_test/sdkconfig.defaults
```kconfig
CONFIG_ESPTOOLPY_FLASHMODE_QIO=y
CONFIG_ESPTOOLPY_FLASHFREQ_120M=y
CONFIG_ESPTOOLPY_FLASHSIZE_8MB=y
CONFIG_PARTITION_TABLE_CUSTOM=y
CONFIG_PARTITION_TABLE_CUSTOM_FILENAME="partitions.csv"
CONFIG_FATFS_LFN_HEAP=y
CONFIG_ESP_MAIN_TASK_STACK_SIZE=16384
CONFIG_ESP_DEFAULT_CPU_FREQ_MHZ_240=y
CONFIG_FREERTOS_HZ=1000
CONFIG_ESP_TASK_WDT_EN=n
CONFIG_CLAW_AGENT_MGR_MAX_SUBAGENTS=3
```

## components/claw_modules/claw_skill/Kconfig
```kconfig
menu "Claw Skill"

config CLAW_SKILL_DEBUG_LOG
    bool "Enable claw_skill debug logs"
    default n
    help
        Enable internal debug logs for claw_skill.

endmenu
```
