## application/edge_agent/boards/QDTFT/QDTFT_2_8_ESP32_S3_Board/sdkconfig.defaults.board
```kconfig
CONFIG_ESP_DEFAULT_CPU_FREQ_MHZ_240=y
CONFIG_ESPTOOLPY_FLASHMODE_QIO=y
CONFIG_ESPTOOLPY_FLASHFREQ_80M=y
CONFIG_ESPTOOLPY_FLASHSIZE_16MB=y
CONFIG_ESPTOOLPY_FLASH_SIZE=16777216
CONFIG_SPIRAM=y
CONFIG_SPIRAM_MODE_OCT=y
CONFIG_SPIRAM_SPEED_80M=y
CONFIG_SPIRAM_ALLOW_BSS_SEG_EXTERNAL_MEMORY=y
CONFIG_SPIRAM_ALLOW_NOINIT_SEG_EXTERNAL_MEMORY=y
CONFIG_SPIRAM_MEMTEST=n
CONFIG_SPIRAM_MALLOC_ALWAYSINTERNAL=0
CONFIG_SPIRAM_TRY_ALLOCATE_WIFI_LWIP=y
CONFIG_SPIRAM_XIP_FROM_PSRAM=y
CONFIG_ESP32S3_SPIRAM_SUPPORT=y
CONFIG_APP_CLAW_LUA_MODULE_LCD=y
CONFIG_PARTITION_TABLE_CUSTOM=y
CONFIG_PARTITION_TABLE_CUSTOM_FILENAME="partitions_16MB.csv"
```

## application/edge_agent/boards/adafruit/metro_esp32s3/sdkconfig.defaults.board
```kconfig
CONFIG_ESP_DEFAULT_CPU_FREQ_MHZ_240=y

# Adafruit Metro ESP32-S3: 16MB QIO flash @ 80MHz
CONFIG_ESPTOOLPY_FLASHMODE_QIO=y
CONFIG_ESPTOOLPY_FLASHFREQ_80M=y
CONFIG_ESPTOOLPY_FLASHSIZE_16MB=y
CONFIG_PARTITION_TABLE_CUSTOM=y
CONFIG_PARTITION_TABLE_CUSTOM_FILENAME="partitions_16MB.csv"

# 8MB OPI PSRAM @ 80MHz
CONFIG_SPIRAM=y
CONFIG_SPIRAM_MODE_OCT=y
CONFIG_SPIRAM_SPEED_80M=y
```

## application/edge_agent/boards/espressif/esp32_s3_eye/sdkconfig.defaults.board
```kconfig
CONFIG_ESP_DEFAULT_CPU_FREQ_MHZ_240=y
CONFIG_ESPTOOLPY_FLASHMODE_QIO=y
CONFIG_ESPTOOLPY_FLASHFREQ_80M=y
CONFIG_ESPTOOLPY_FLASHSIZE_8MB=y
CONFIG_SPIRAM=y
CONFIG_SPIRAM_MODE_OCT=y
CONFIG_SPIRAM_SPEED_80M=y
CONFIG_APP_CLAW_LUA_MODULE_LCD=y

# Primary console over native USB-Serial-JTAG
CONFIG_ESP_CONSOLE_USB_SERIAL_JTAG=y
```

## application/edge_agent/boards/lilygo/lilygo_t_connect_pro_s3/sdkconfig.defaults.board
```kconfig
CONFIG_ESP_DEFAULT_CPU_FREQ_MHZ_240=y
CONFIG_ESPTOOLPY_FLASHMODE_QIO=y
CONFIG_ESPTOOLPY_FLASHFREQ_120M=y
CONFIG_ESPTOOLPY_FLASHSIZE_16MB=y
CONFIG_PARTITION_TABLE_CUSTOM=y
CONFIG_PARTITION_TABLE_CUSTOM_FILENAME="partitions_16MB_emote.csv"
CONFIG_SPIRAM=y
CONFIG_SPIRAM_MODE_OCT=y
CONFIG_SPIRAM_SPEED_120M=y

CONFIG_ESP_BOARD_PERIPH_I2S_SUPPORT=y
CONFIG_ESP_VIDEO_ENABLE_USB_UVC_VIDEO_DEVICE=y
CONFIG_USB_HOST_CONTROL_TRANSFER_MAX_SIZE=1024
CONFIG_USB_UVC_VIDEO_DEVICE_URB_SIZE=4096

CONFIG_EDGE_AGENT_ENABLE_EMOTE=y
CONFIG_EMOTE_DEF_BG_COLOR=0x171617
```

## application/edge_agent/main/Kconfig.projbuild
```kconfig
menu "App Config"

menu "Default Wi-Fi Settings"

    config APP_WIFI_SSID
        string "Default Wi-Fi SSID"
        default ""
        help
            Default Wi-Fi SSID used to populate app settings.

    config APP_WIFI_PASSWORD
        string "Default Wi-Fi password"
        default ""
        help
            Default Wi-Fi password used to populate app settings.

    config APP_WIFI_AP_SSID_PREFIX
        string "Provisioning AP SSID prefix"
        default "esp-claw"
        help
            Prefix used to build the unique provisioning AP SSID. The full
            SSID is "<prefix>-<MAC[3..5]>" (e.g. esp-claw-84AEE5).

    config APP_WIFI_AP_CHANNEL
        int "Provisioning AP channel"
        range 1 13
        default 1
        help
            Channel used by the provisioning SoftAP.

    config APP_WIFI_AP_MAX_CONN
        int "Provisioning AP max connections"
        range 1 10
        default 4
        help
            Maximum number of concurrent stations on the provisioning AP.

    config APP_WIFI_MAX_RETRY
        int "STA max retries before AP fallback"
        range 1 20
        default 5
        help
            After this many consecutive STA connection failures the device
            falls back to pure AP mode and waits for the user to provision
            new credentials.

    config APP_WIFI_AP_AUTO_CLOSE
        bool "Close provisioning AP after STA connects"
        default y
        help
            When enabled, the SoftAP used for provisioning is shut down
            shortly after the device successfully joins the configured
            STA network. This reduces the attack surface of the always-on
            captive portal. The AP is reopened automatically if STA
            credentials become invalid (after APP_WIFI_MAX_RETRY failures).

    config APP_WIFI_AP_AUTO_CLOSE_DELAY_MS
        int "Grace period before closing the AP (ms)"
        depends on APP_WIFI_AP_AUTO_CLOSE
        range 0 60000
        default 3000
        help
            Time to keep the SoftAP up after STA gets an IP, so any client
            still on the captive portal can receive its last response
            before the AP goes away.

endmenu

endmenu
```

## application/rover_demo/boards/m5stickc_plus/sdkconfig.defaults.board
```kconfig
CONFIG_IDF_TARGET="esp32"
CONFIG_IDF_TARGET_ESP32=y
CONFIG_FREERTOS_UNICORE=n
CONFIG_FREERTOS_HZ=1000
```

## application/rover_demo/main/Kconfig.projbuild
```kconfig
menu "Rover Demo Configuration"

config ROVER_DEMO_WIFI_SSID
    string "Default Wi-Fi SSID"
    default ""

config ROVER_DEMO_WIFI_PASSWORD
    string "Default Wi-Fi password"
    default ""

config ROVER_DEMO_LLM_API_KEY
    string "Default LLM API key"
    default ""

config ROVER_DEMO_LLM_BACKEND_TYPE
    string "Default LLM backend type"
    default "openai_compatible"

config ROVER_DEMO_LLM_PROFILE
    string "Default LLM profile"
    default "openai"

config ROVER_DEMO_LLM_MODEL
    string "Default LLM model"
    default "openrouter/auto"

config ROVER_DEMO_LLM_BASE_URL
    string "Default LLM base URL"
    default "https://openrouter.ai/api/v1"

config ROVER_DEMO_LLM_AUTH_TYPE
    string "Default LLM auth type"
    default "bearer"

config ROVER_DEMO_LLM_TIMEOUT_MS
    string "Default LLM timeout ms"
    default "30000"

config ROVER_DEMO_TG_BOT_TOKEN
    string "Default Telegram bot token"
    default ""

config ROVER_DEMO_TIME_TIMEZONE
    string "Default timezone (POSIX TZ string)"
    default "UTC0"

endmenu
```

## application/rover_demo/sdkconfig.defaults
```kconfig
CONFIG_ESP32_DEFAULT_CPU_FREQ_240=y
CONFIG_SPIRAM_SUPPORT=n
CONFIG_ESP_MAIN_TASK_STACK_SIZE=6144
CONFIG_ESP_TIMER_TASK_STACK_SIZE=4096
CONFIG_MBEDTLS_DYNAMIC_BUFFER=y
CONFIG_MBEDTLS_DYNAMIC_FREE_PEER_CERT=y
CONFIG_MBEDTLS_DYNAMIC_FREE_CONFIG_DATA=y
CONFIG_MBEDTLS_SSL_OUT_CONTENT_LEN=8192
CONFIG_ESP_HTTP_CLIENT_ENABLE_HTTPS=y
CONFIG_LOG_DEFAULT_LEVEL_INFO=y
CONFIG_LOG_MAXIMUM_LEVEL_DEBUG=y
CONFIG_ESP_CONSOLE_UART_DEFAULT=y
CONFIG_FATFS_LFN_HEAP=y
CONFIG_FATFS_MAX_LFN=255
CONFIG_FATFS_API_ENCODING_UTF_8=y
CONFIG_ESP_TASK_WDT_INIT=y
CONFIG_ESP_TASK_WDT_TIMEOUT_S=15
CONFIG_PARTITION_TABLE_CUSTOM=y
CONFIG_PARTITION_TABLE_CUSTOM_FILENAME="partitions.csv"
CONFIG_ESPTOOLPY_FLASHSIZE_4MB=y
CONFIG_ESPTOOLPY_FLASHSIZE="4MB"
```

## application/wave_rover/sdkconfig.defaults
```kconfig
CONFIG_ESP_DEFAULT_CPU_FREQ_MHZ_240=y
CONFIG_ESPTOOLPY_FLASHSIZE_4MB=y
CONFIG_PARTITION_TABLE_CUSTOM=y
CONFIG_PARTITION_TABLE_CUSTOM_FILENAME="partitions.csv"
CONFIG_FREERTOS_HZ=1000
CONFIG_ESP_MAIN_TASK_STACK_SIZE=8192
CONFIG_LWIP_LOCAL_HOSTNAME="wave-rover"
CONFIG_MDNS_HOSTNAME="wave-rover"
CONFIG_ESP_WIFI_STATIC_RX_BUFFER_NUM=10
CONFIG_ESP_WIFI_DYNAMIC_RX_BUFFER_NUM=32
CONFIG_ESP_WIFI_TX_BUFFER_TYPE_DYNAMIC=y
CONFIG_HTTPD_MAX_REQ_HDR_LEN=1024
CONFIG_HTTPD_MAX_URI_LEN=512
# MCP SDK: disable HTTP client transport (unused; avoids IDF 6 enum mismatch)
CONFIG_MCP_TRANSPORT_HTTP_CLIENT=n
```

## applications/edge_agent/main/Kconfig.projbuild
```kconfig
menu "App Config"

menu "Default Wi-Fi Credentials"

    config APP_WIFI_SSID
        string "Default Wi-Fi SSID"
        default ""
        help
            Default Wi-Fi SSID used to populate app settings.

    config APP_WIFI_PASSWORD
        string "Default Wi-Fi password"
        default ""
        help
            Default Wi-Fi password used to populate app settings.

endmenu

menu "Default Search Settings"

    config APP_SEARCH_HTTP_ALLOWLIST
        string "Default HTTP Request allowlist"
        default "*"
        help
            Default value used to populate app setting `search_http_allowlist`.
            Use `*` to allow all hosts, or a comma-separated list of domains/IPs.

            e.g. "api.example.com,*.example.org,203.0.113.10"

endmenu

endmenu
```

## components/claw_capabilities/cap_voice/Kconfig
```kconfig
menu "cap_voice"

config CAP_VOICE_ENABLED
    bool "Enable cap_voice component"
    default y


config CAP_VOICE_RECORD_MAX_MS
    int "Maximum recording duration (ms)"
    default 10000

config CAP_VOICE_VAD_SILENCE_MS
    int "Silence duration to stop recording (ms)"
    default 1500

config CAP_VOICE_AUDIO_RECORD_BUF_KB
    int "Audio ring buffer size (KB, PSRAM)"
    default 320

endmenu
```

## components/common/app_ota/Kconfig
```kconfig
menu "App OTA (esp_ota_service)"

    menu "HTTP OTA bootstrap"

        config APP_OTA_HTTP_ENABLE
            bool "Enable optional HTTP firmware OTA bootstrap"
            default n
            help
                When enabled and manifest/firmware URLs are non-empty (menuconfig below),
                the device runs one HTTP OTA check after Wi‑Fi STA is connected during boot.

        if APP_OTA_HTTP_ENABLE

            config APP_OTA_HTTP_RUN_AT_BOOT
                bool "Run HTTP OTA check once at startup (after STA online)"
                default y

            config APP_OTA_HTTP_MANIFEST_URL
                string "Firmware manifest JSON URL (http/https)"
                default ""
                help
                    JSON manifest consumed by esp_ota_service_checker_manifest (version, optional sha256, size).

            config APP_OTA_HTTP_FIRMWARE_URL
                string "Firmware binary URL (must match manifest server)"
                default ""
                help
                    Absolute URL for the downloadable app image (paired with APP_OTA_HTTP_MANIFEST_URL).

            config APP_OTA_HTTP_CHUNK_TIMEOUT_MS
                int "HTTP read timeout per chunk (milliseconds)"
                default 30000
                range 3000 120000

        endif # APP_OTA_HTTP_ENABLE

    endmenu

    menu "Filesystem OTA bootstrap"

        config APP_OTA_FS_ENABLE
            bool "Enable optional filesystem (VFS) app OTA bootstrap"
            default y
            help
                After SPI flash FAT mounts (typically /fatfs), read a staged edge_agent.bin from an absolute path
                using esp_ota_service_source_fs. Runs **before Wi-Fi**. File must expose a higher semver than running
                image when APP_OTA_FS_REQUIRE_NEWER_SEMVER=y.

        if APP_OTA_FS_ENABLE

            config APP_OTA_FS_RUN_AT_BOOT
                bool "Run FS OTA when candidate file exists at boot"
                default y

            config APP_OTA_FS_FIRMWARE_ABS_PATH
                string "Absolute filesystem path (VFS fopen) for app binary"
                default "/fatfs/ota/firmware.bin"
                help
                    Typical layout: mkdir /fatfs/ota via host mount and drop edge_agent.bin renamed to firmware.bin.

            config APP_OTA_FS_TRY_SDCARD_AT_BOOT
                bool "Before SPI flash FAT, try app OTA from SD (board_manager fs_sdcard)"
                default n
                help
                    After esp_board_manager_init(), if the board exposes fs_sdcard (usually mounted at /sdcard),
                    probe APP_OTA_FS_SDCARD_FIRMWARE_ABS_PATH for a newer app image.
                    Matches esp_ota_service tools/sdcard_writer output name firmware.bin.
                    Use together with tools/ota_sdcard_hil.py and ota_fs_flash_sdcard.py from ADF.

            config APP_OTA_FS_SDCARD_FIRMWARE_ABS_PATH
                string "Absolute path on SD mount for app binary"
                default "/sdcard/firmware.bin"
                depends on APP_OTA_FS_TRY_SDCARD_AT_BOOT
                help
                    Default matches sdcard_writer (components/esp_ota_service/tools/sdcard_writer).

            config APP_OTA_FS_READ_BUF_BYTES
                int "Read buffer chunk size passed to filesystem source"
                default 4096
                range 512 8192

            config APP_OTA_FS_REQUIRE_NEWER_SEMVER
                bool "Reject candidate whose esp_app_desc_t version is not strictly higher"
                default y

            config APP_OTA_FS_CHECK_PROJECT_NAME
                bool "Reject candidate when esp_app_desc_t project_name differs from running firmware"
                default y

        endif # APP_OTA_FS_ENABLE

    endmenu

endmenu
```

## components/lua_modules/lua_module_board_manager/Kconfig
```kconfig
menu "Lua Board Manager Module"

    choice LUA_MODULE_BOARD_MANAGER_DISPLAY_SHAPE
        prompt "Visible display shape"
        default LUA_MODULE_BOARD_MANAGER_DISPLAY_SHAPE_RECT
        help
            Physical outline of the visible display area, reported by
            board_manager.get_display_shape(). Apps use it to keep controls
            away from areas the panel cannot show. Boards set it in
            sdkconfig.defaults.board.

        config LUA_MODULE_BOARD_MANAGER_DISPLAY_SHAPE_RECT
            bool "Rectangle"

        config LUA_MODULE_BOARD_MANAGER_DISPLAY_SHAPE_ROUNDED_RECT
            bool "Rounded rectangle"

        config LUA_MODULE_BOARD_MANAGER_DISPLAY_SHAPE_CIRCLE
            bool "Circle"
    endchoice

    config LUA_MODULE_BOARD_MANAGER_DISPLAY_CORNER_RADIUS
        int "Display corner radius in pixels"
        depends on LUA_MODULE_BOARD_MANAGER_DISPLAY_SHAPE_ROUNDED_RECT
        default 40
        range 1 1024
        help
            Radius of each visible corner. A circular display uses half of its
            shorter side and ignores this value.

endmenu
```

## components/lua_modules/lua_module_camera/Kconfig
```kconfig
menu "Lua Camera Module"
    depends on APP_CLAW_CAP_LUA
    depends on APP_CLAW_LUA_MODULE_CAMERA

    config LUA_MODULE_CAMERA_ENABLE_VFLIP
        bool "Camera vertical flip"
        default y
        help
            Set V4L2_CID_VFLIP to 1 when enabled or 0 when disabled whenever
            camera.open() starts a camera stream.

    config LUA_MODULE_CAMERA_ENABLE_HMIRROR
        bool "Camera horizontal mirror"
        default n
        help
            Set V4L2_CID_HFLIP to 1 when enabled or 0 when disabled whenever
            camera.open() starts a camera stream.

endmenu
```
